## CMakeLists.txt
```
# SPDX-License-Identifier: Apache-2.0

cmake_minimum_required(VERSION 3.13.1)

include($ENV{ZEPHYR_BASE}/cmake/app/boilerplate.cmake NO_POLICY_SCOPE)

project(IoTPatch)

set(IOTPATCH_DIR ${CMAKE_CURRENT_SOURCE_DIR}/../../PatchCore/)

message("======================================")
message(${IOTPATCH_DIR})
message("======================================")

file(GLOB iotpatchsrc
        "${IOTPATCH_DIR}/hotpatch/include/*.h"
        "${IOTPATCH_DIR}/hotpatch/src/*.c"
        "${IOTPATCH_DIR}/app/*.h"
        "${IOTPATCH_DIR}/app/*.c"
        "${IOTPATCH_DIR}/libebpf/include/*.h"
        "${IOTPATCH_DIR}/libebpf/src/*.c")

list(REMOVE_ITEM iotpatchsrc "${IOTPATCH_DIR}/libebpf/src/main.c")

include($ENV{ZEPHYR_BASE}/samples/net/common/common.cmake)

include_directories(
        "${IOTPATCH_DIR}/"
        "${IOTPATCH_DIR}/hotpatch"
        "${IOTPATCH_DIR}/app"
        "${IOTPATCH_DIR}/libebpf"
        "./src/mqtt"
        # "./src/coap"
        "$ENV{ZEPHYR_BASE}/subsys/net/ip"
)

add_definitions(-DSYS_CORTEX_M4 -DZEPHYR_OS -DDEV_NRF52840 -DDEV_MQTT)

target_sources(app PRIVATE ${iotpatchsrc} src/main.c src/mqtt/mqtt-subscriber.c)
```

## prj.conf
```kconfig
CONFIG_CONSOLE_SUBSYS=y
CONFIG_CONSOLE_GETCHAR=y
CONFIG_CONSOLE_GETCHAR_BUFSIZE=64
CONFIG_CONSOLE_PUTCHAR_BUFSIZE=512
CONFIG_HEAP_MEM_POOL_SIZE=8192

# CONFIG_STACK_CANARIES=y
CONFIG_NETWORKING=y
CONFIG_NEWLIB_LIBC=y
CONFIG_NET_IPV6=y
CONFIG_NET_UDP=y

CONFIG_NET_SOCKETS=y
CONFIG_NET_SOCKETS_POSIX_NAMES=y
CONFIG_NET_SOCKETS_POLL_MAX=4

CONFIG_COAP=y

# CONFIG_HAS_SEGGER_RTT=y
# CONFIG_USE_SEGGER_RTT=y
# CONFIG_RTT_CONSOLE=n
CONFIG_UART_CONSOLE=y

CONFIG_NO_OPTIMIZATIONS=n
CONFIG_MPU_STACK_GUARD=n
# CONFIG_STACK_SENTINEL=y

CONFIG_ARCH_HAS_RAMFUNC_SUPPORT=y
```

## overlay-mqtt.conf
```kconfig
CONFIG_NETWORKING=y
CONFIG_NET_SOCKETS=y
CONFIG_NET_TCP=y
CONFIG_NET_LOG=y
# CONFIG_NET_CONFIG_LOG_LEVEL_ERR=y

CONFIG_NET_IPV6_RA_RDNSS=y
CONFIG_NET_IF_UNICAST_IPV6_ADDR_COUNT=3
CONFIG_NET_IF_MCAST_IPV6_ADDR_COUNT=2

CONFIG_PRINTK=n
CONFIG_STDOUT_CONSOLE=y

# Enable IPv6 support
CONFIG_NET_IPV6=n
# Enable IPv4 support
CONFIG_NET_IPV4=y

# Enable the MQTT Lib
CONFIG_MQTT_LIB=y

CONFIG_NET_CONFIG_SETTINGS=y
CONFIG_NET_CONFIG_MY_IPV6_ADDR="2001:db8::1"
CONFIG_NET_CONFIG_PEER_IPV6_ADDR="2001:db8::2"

CONFIG_NET_CONFIG_MY_IPV4_ADDR="192.0.2.3"
CONFIG_NET_CONFIG_PEER_IPV4_ADDR="192.0.2.1"

CONFIG_MAIN_STACK_SIZE=4096
CONFIG_HEAP_MEM_POOL_SIZE=4096

CONFIG_SYSTEM_WORKQUEUE_STACK_SIZE=4096
CONFIG_ISR_STACK_SIZE=4096

# CONFIG_ARM_MPU=n
# CONFIG_HW_STACK_PROTECTION=n

# For IPv6
CONFIG_NET_BUF_DATA_SIZE=256

# CONFIG_NET_SHELL=y



###### USB networking ######
# USB Device settings
CONFIG_USB=y
CONFIG_USB_DEVICE_STACK=y

# Select USB Configurations
CONFIG_USB_DEVICE_NETWORK_ECM=y
# CONFIG_USB_DEVICE_NETWORK_RNDIS=y
CONFIG_USB_DEVICE_OS_DESC=y
# CONFIG_HELLO=y
CONFIG_TINYCBOR=n

# Logging
CONFIG_USB_DRIVER_LOG_LEVEL_INF=y
CONFIG_USB_DEVICE_LOG_LEVEL_INF=y
CONFIG_INIT_STACKS=n

# Disable shell built-in commands to reduce ROM footprint
# CONFIG_SHELL_CMDS=y

# RTT
# CONFIG_HAS_SEGGER_RTT=y
# CONFIG_USE_SEGGER_RTT=y
```

## src/main.c
```c
/*
 * Copyright (c) 2012-2014 Wind River Systems, Inc.
 *
 * SPDX-License-Identifier: Apache-2.0
 */

#include <zephyr.h>
#include <misc/printk.h>
#include <console.h>
#include <stdio.h>
#include <string.h>

#include "include/patch_service.h"
#include "include/iotpatch.h"
#include "libebpf/include/ebpf_allocator.h"
#include "include/utils.h"

#include "hotpatch/include/profiling.h"

#include "app/ihp_cli.h"

#ifdef DEV_MQTT
#include "config.h"
#endif


K_THREAD_DEFINE(cli_thread, STACK_SIZE,
	run_shell_cli, NULL, NULL, NULL,
	THREAD_PRIORITY, 0, K_FOREVER);

static void load_fixed_patch_0(void);
static void ebpf_test();
// extern void arm_core_mpu_disable();
void main(void)
{
	#define USE_JIT
	#ifdef USE_JIT
	// disable mpu
	arm_core_mpu_disable();
	// https://lists.zephyrproject.org/g/users/topic/random_fault_exception/30793151?p=
	// CONFIG_NO_OPTIMIZATIONS=y
	#endif

	console_init();
	//printk("Hello World! %s\n", CONFIG_BOARD);
	k_thread_start(cli_thread);

	//run_coap_server();
	profile_add_event("micro profile dynamic start");
	profile_add_event("micro profile fixed start");
	profile_add_event("uart print profile start");
	profile_add_event("eBPF exec time evaluation start");

	#ifdef DEV_MQTT
	run_mqtt_subscriber();
	#endif
}
```
