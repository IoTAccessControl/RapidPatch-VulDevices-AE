## CMakeLists.txt
```
# SPDX-License-Identifier: Apache-2.0

cmake_minimum_required(VERSION 3.13.1)

include($ENV{ZEPHYR_BASE}/cmake/app/boilerplate.cmake NO_POLICY_SCOPE)

project(IoTPatch)

set(IOTPATCH_DIR ${CMAKE_CURRENT_SOURCE_DIR}/../../RapidPatch-Runtime-AE/)

message("======================================")
message("PatchCore:" ${IOTPATCH_DIR} "  PROJ:" ${PROJECT_SOURCE_DIR})
message("======================================")

file(GLOB iotpatchsrc
        "${IOTPATCH_DIR}/hotpatch/include/*.h"
        "${IOTPATCH_DIR}/hotpatch/src/*.c"
        "${IOTPATCH_DIR}/app/*.h"
        "${IOTPATCH_DIR}/app/*.c"
        "${IOTPATCH_DIR}/libebpf/include/*.h"
        "${IOTPATCH_DIR}/libebpf/src/*.c")

list(REMOVE_ITEM iotpatchsrc "${IOTPATCH_DIR}/libebpf/src/main.c")

include($ENV{ZEPHYR_BASE}/samples/net/common/common.cmake)

include_directories(
        "${IOTPATCH_DIR}/"
        "${IOTPATCH_DIR}/hotpatch"
        "${IOTPATCH_DIR}/app"
        "${IOTPATCH_DIR}/libebpf"
        "${PROJECT_SOURCE_DIR}/src/mqtt"
        "${PROJECT_SOURCE_DIR}/src/coap"
        "$ENV{ZEPHYR_BASE}/subsys/net/ip"
)

# add_definitions(-DSYS_CORTEX_M4 -DZEPHYR_OS)
# add_definitions(-DSYS_CORTEX_M4 -DZEPHYR_OS -DDEV_STM32F429)
# add_definitions(-DSYS_CORTEX_M4 -DZEPHYR_OS -DDEV_STM32F429 -DDEV_MQTT)

# target_compile_options(app PRIVATE -finstrument-functions) 
# 只加单个目录
# add_compile_options(-finstrument-functions)

# target_sources(app PRIVATE src/main_empty.c src/coap/coap-server.c)
# target_sources(app PRIVATE ${iotpatchsrc} src/main.c)


# coap
# add_definitions(-DSYS_CORTEX_M4 -DZEPHYR_OS -DDEV_NRF52840 -DDEV_COAP)
# target_sources(app PRIVATE ${iotpatchsrc} src/main.c src/coap/coap-server.c)


# mqtt
# add_definitions(-DSYS_CORTEX_M4 -DZEPHYR_OS -DDEV_NRF52840 -DDEV_MQTT)
# target_sources(app PRIVATE ${iotpatchsrc} src/main.c src/mqtt/mqtt-subscriber.c)

# basic system and usb
target_sources(app PRIVATE ${iotpatchsrc} src/main.c)
add_definitions(-DSYS_CORTEX_M4 -DZEPHYR_OS -DDEV_NRF52840)
```

## prj.conf
```kconfig
CONFIG_CONSOLE_SUBSYS=y
CONFIG_CONSOLE_GETCHAR=y
CONFIG_CONSOLE_GETCHAR_BUFSIZE=64
CONFIG_CONSOLE_PUTCHAR_BUFSIZE=512
CONFIG_HEAP_MEM_POOL_SIZE=8192

# CONFIG_STACK_CANARIES=y
CONFIG_NETWORKING=y
CONFIG_NEWLIB_LIBC=y
CONFIG_NET_IPV6=y
CONFIG_NET_UDP=y

CONFIG_NET_SOCKETS=y
CONFIG_NET_SOCKETS_POSIX_NAMES=y
CONFIG_NET_SOCKETS_POLL_MAX=4

CONFIG_COAP=y

CONFIG_HAS_SEGGER_RTT=y
# CONFIG_USE_SEGGER_RTT=y
# CONFIG_RTT_CONSOLE=n
CONFIG_UART_CONSOLE=y

# CONFIG_NO_OPTIMIZATIONS=y
```

## nrf52840_usb.conf
```kconfig
# USB MASS
CONFIG_STDOUT_CONSOLE=y
CONFIG_GPIO=y
CONFIG_USB=y
CONFIG_USB_DEVICE_STACK=y
CONFIG_USB_DEVICE_PRODUCT="Zephyr MSC sample"
CONFIG_LOG=y
CONFIG_USB_DRIVER_LOG_LEVEL_ERR=y
CONFIG_USB_MASS_STORAGE=y
CONFIG_USB_DEVICE_LOG_LEVEL_ERR=y
CONFIG_USB_MASS_STORAGE_LOG_LEVEL_ERR=y
CONFIG_DISK_ACCESS_RAM=y
CONFIG_MASS_STORAGE_DISK_NAME="RAM"
```

## overlay-coapperf.conf
```kconfig
# Generic networking options
CONFIG_NETWORKING=y
CONFIG_NEWLIB_LIBC=y
CONFIG_NET_UDP=y

# Socket
CONFIG_NET_SOCKETS=y
CONFIG_NET_SOCKETS_POSIX_NAMES=y
CONFIG_NET_SOCKETS_POLL_MAX=4

# CoAP
CONFIG_COAP=y
CONFIG_COAP_WELL_KNOWN_BLOCK_WISE=y

# Kernel options
CONFIG_ENTROPY_GENERATOR=y
CONFIG_TEST_RANDOM_GENERATOR=y

# Logging
CONFIG_LOG=n
CONFIG_PRINTK=n
CONFIG_NET_LOG=n

# Network Shell
# CONFIG_NET_SHELL=y

CONFIG_MAIN_STACK_SIZE=2048
CONFIG_HEAP_MEM_POOL_SIZE=2048

# Configuration
CONFIG_NET_CONFIG_SETTINGS=y

# Enable only one protocol, if you enable both sources
# won't compile.
# IPv6 Support
CONFIG_NET_IPV6=n
CONFIG_NET_CONFIG_NEED_IPV6=n
CONFIG_NET_CONFIG_MY_IPV6_ADDR="2001:db8::1"
CONFIG_NET_IF_MCAST_IPV6_ADDR_COUNT=5

#IPv4 Support
CONFIG_NET_IPV4=y
CONFIG_NET_CONFIG_NEED_IPV4=y
CONFIG_NET_CONFIG_MY_IPV4_ADDR="192.0.2.3"


###### USB networking ######
# USB Device settings
CONFIG_USB=y
CONFIG_USB_DEVICE_STACK=y

# Select USB Configurations
CONFIG_USB_DEVICE_NETWORK_ECM=y
# CONFIG_USB_DEVICE_NETWORK_RNDIS=y
CONFIG_USB_DEVICE_OS_DESC=y
# CONFIG_HELLO=y
CONFIG_TINYCBOR=n

# Logging
CONFIG_USB_DRIVER_LOG_LEVEL_INF=y
CONFIG_USB_DEVICE_LOG_LEVEL_INF=y
CONFIG_INIT_STACKS=n

# Disable shell built-in commands to reduce ROM footprint
# CONFIG_SHELL_CMDS=y

# RTT
CONFIG_HAS_SEGGER_RTT=y
CONFIG_USE_SEGGER_RTT=y
```

## overlay-mqtt.conf
```kconfig
CONFIG_NETWORKING=y
CONFIG_NET_SOCKETS=y
CONFIG_NET_TCP=y
CONFIG_NET_LOG=n

CONFIG_NET_IPV6_RA_RDNSS=y
CONFIG_NET_IF_UNICAST_IPV6_ADDR_COUNT=3
CONFIG_NET_IF_MCAST_IPV6_ADDR_COUNT=2

CONFIG_PRINTK=n
CONFIG_STDOUT_CONSOLE=y

# Enable IPv6 support
CONFIG_NET_IPV6=n
# Enable IPv4 support
CONFIG_NET_IPV4=y

# Enable the MQTT Lib
CONFIG_MQTT_LIB=y

CONFIG_NET_CONFIG_SETTINGS=y
CONFIG_NET_CONFIG_MY_IPV6_ADDR="2001:db8::1"
CONFIG_NET_CONFIG_PEER_IPV6_ADDR="2001:db8::2"

CONFIG_NET_CONFIG_MY_IPV4_ADDR="192.0.2.3"
CONFIG_NET_CONFIG_PEER_IPV4_ADDR="192.0.2.1"

CONFIG_MAIN_STACK_SIZE=2048

# For IPv6
CONFIG_NET_BUF_DATA_SIZE=256

# CONFIG_NET_SHELL=y



###### USB networking ######
# USB Device settings
CONFIG_USB=y
CONFIG_USB_DEVICE_STACK=y

# Select USB Configurations
CONFIG_USB_DEVICE_NETWORK_ECM=y
# CONFIG_USB_DEVICE_NETWORK_RNDIS=y
CONFIG_USB_DEVICE_OS_DESC=y
# CONFIG_HELLO=y
CONFIG_TINYCBOR=n

# Logging
CONFIG_USB_DRIVER_LOG_LEVEL_INF=y
CONFIG_USB_DEVICE_LOG_LEVEL_INF=y
CONFIG_INIT_STACKS=n

# Disable shell built-in commands to reduce ROM footprint
# CONFIG_SHELL_CMDS=y

# RTT
# CONFIG_HAS_SEGGER_RTT=y
# CONFIG_USE_SEGGER_RTT=y
# CONFIG_NO_OPTIMIZATIONS=y
#CONFIG_STACK_CANARIES=y
```

## overlay-netusb.conf
```kconfig
# USB Device settings
CONFIG_USB=y
CONFIG_USB_DEVICE_STACK=y

# Select USB Configurations
CONFIG_USB_DEVICE_NETWORK_ECM=y
# CONFIG_USB_DEVICE_NETWORK_RNDIS=y
CONFIG_USB_DEVICE_OS_DESC=y
# CONFIG_HELLO=y
CONFIG_TINYCBOR=n

# Logging
CONFIG_USB_DRIVER_LOG_LEVEL_INF=y
CONFIG_USB_DEVICE_LOG_LEVEL_INF=y
CONFIG_INIT_STACKS=n

# Disable shell built-in commands to reduce ROM footprint
# CONFIG_SHELL_CMDS=n

# RTT
# CONFIG_HAS_SEGGER_RTT=y
# CONFIG_USE_SEGGER_RTT=y
# CONFIG_RTT_CONSOLE=y
# CONFIG_UART_CONSOLE=n


###### USB NETWORKING ######
# Generic networking options
CONFIG_NETWORKING=y
CONFIG_NET_UDP=n
CONFIG_NET_TCP=y
CONFIG_NET_IPV6=n
CONFIG_NET_IPV4=y
CONFIG_NET_SOCKETS=y
CONFIG_NET_SOCKETS_POSIX_NAMES=y
CONFIG_NET_SOCKETS_POLL_MAX=4

# Kernel options
CONFIG_MAIN_STACK_SIZE=2048
CONFIG_ENTROPY_GENERATOR=y
# CONFIG_TEST_RANDOM_GENERATOR=y
CONFIG_INIT_STACKS=y

# Logging
CONFIG_NET_LOG=y
CONFIG_LOG=y
CONFIG_NET_STATISTICS=y
CONFIG_PRINTK=y

# Network buffers
CONFIG_NET_PKT_RX_COUNT=16
CONFIG_NET_PKT_TX_COUNT=16
CONFIG_NET_BUF_RX_COUNT=80
CONFIG_NET_BUF_TX_COUNT=80
CONFIG_NET_CONTEXT_NET_PKT_POOL=y

# IP address options
# CONFIG_NET_IF_UNICAST_IPV6_ADDR_COUNT=3
# CONFIG_NET_IF_MCAST_IPV6_ADDR_COUNT=4
CONFIG_NET_MAX_CONTEXTS=10

# Network shell
# CONFIG_NET_SHELL=y

# The addresses are selected so that qemu<->qemu connectivity works ok.
# For linux<->qemu connectivity, create a new conf file and swap the
# addresses (so that peer address is ending to 2).
CONFIG_NET_CONFIG_SETTINGS=y
# CONFIG_NET_CONFIG_MY_IPV6_ADDR="2001:db8::2"
# CONFIG_NET_CONFIG_PEER_IPV6_ADDR="2001:db8::1"
CONFIG_NET_CONFIG_MY_IPV4_ADDR="192.0.2.3"
CONFIG_NET_CONFIG_PEER_IPV4_ADDR="192.0.2.1"
```

## overlay-shell.conf
```kconfig
CONFIG_SHELL=y
CONFIG_CONSOLE_SUBSYS=y
CONFIG_CONSOLE_GETCHAR=y
```

## overlay-syscall.conf
```kconfig
CONFIG_USERSPACE=y
CONFIG_LOG=y
```

## src/main.c
```c
/*
 * Copyright (c) 2012-2014 Wind River Systems, Inc.
 *
 * SPDX-License-Identifier: Apache-2.0
 */

#include <zephyr.h>
#include <misc/printk.h>
#include <console.h>
#include <stdio.h>
#include <string.h>

#include "include/patch_service.h"
#include "include/iotpatch.h"
#include "libebpf/include/ebpf_allocator.h"
#include "include/utils.h"

#include "hotpatch/include/profiling.h"

#include "app/ihp_cli.h"

#ifdef DEV_COAP
#include "common.h"
#else
#define STACK_SIZE 1024
#define THREAD_PRIORITY K_PRIO_COOP(8)
#endif

#ifdef DEV_MQTT
#include "config.h"
#endif




K_THREAD_DEFINE(cli_thread, STACK_SIZE,
	run_shell_cli, NULL, NULL, NULL,
	THREAD_PRIORITY, 0, K_FOREVER);

static void load_fixed_patch_0(void);
static void ebpf_test();
extern void arm_core_mpu_disable();
void main(void)
{
	#define USE_JIT
	#ifdef USE_JIT
	// disable mpu
	arm_core_mpu_disable();
	// https://lists.zephyrproject.org/g/users/topic/random_fault_exception/30793151?p=
	// CONFIG_NO_OPTIMIZATIONS=y
	#endif

	console_init();
	printk("Hello World! %s v:%f\n", CONFIG_BOARD, 1.45);
	k_thread_start(cli_thread);

	//run_coap_server();
	// profile_add_event("micro profile dynamic start");
	// profile_add_event("micro profile fixed start");
	// profile_add_event("uart print profile start");
	// profile_add_event("eBPF exec time evaluation start");

	#ifdef DEV_COAP
	// run_coap_server();
	#endif

	#ifdef DEV_MQTT
	run_mqtt_subscriber();
	#endif



	// ebpf_test();
}

#define __NAKE __attribute__((naked))
#define __NOIST __attribute__((no_instrument_function))

// void __attribute__((no_instrument_function, naked)) 
// restore_context() {
// 	__asm__ __volatile__("BX lr");
// }

// void __attribute__((no_instrument_function))
// _patch_dispatch(uint32_t *ctx) {
// 	printf("_patch_dispatch: %p\n", ctx);
// 	// restore_context();
// 	printf("after _patch_dispatch\n");
// }

// void __attribute__((no_instrument_function, naked))
// __cyg_profile_func_enter(void *this_func, void *call_site) {
// 	//__asm("push {r0-r3, r12, lr}");
// 	//print_str("enter func\n");
// 	__asm__ __volatile__("PUSH {lr}");
// 	__asm__ __volatile__("TST lr, #4");
// 	__asm__ __volatile__("ITE EQ"); 
// 	__asm__ __volatile__("MRSEQ r0, MSP"); 
// 	__asm__ __volatile__("MRSNE r0, PSP"); 
// 	__asm__ __volatile__("B _patch_dispatch"); 
// 	__asm__ __volatile__("POP {lr}");
// 	__asm__ __volatile__("BX lr");
// }

// void __attribute__((no_instrument_function))
// __cyg_profile_func_exit(void *this_fn, void *call_site) {
// 	printf("exit func\n");
// }
```
